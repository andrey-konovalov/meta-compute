## conf/layer.conf
```bitbake
# We have a conf and classes directory, add to BBPATH
BBPATH .= ":${LAYERDIR}"

# We have recipes-* directories, add to BBFILES
BBFILES += "${LAYERDIR}/recipes-*/*/*.bb \
	${LAYERDIR}/recipes-*/*/*.bbappend"

BBFILE_COLLECTIONS += "compute"
BBFILE_PATTERN_compute := "^${LAYERDIR}/"
BBFILE_PRIORITY_compute = "7"

LAYERSERIES_COMPAT_compute = "dunfell"
```
